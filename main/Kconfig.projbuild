## main/Kconfig.projbuild
```kconfig
menu "Atari STE emulator"

    choice ST_TOS
        prompt "TOS version"
        default ST_TOS_162
        help
            TOS image to boot, from its flash partition (roms/tosNNN.img).

        config ST_TOS_162
            bool "TOS 1.62 (tos162 partition)"
        config ST_TOS_206
            bool "TOS 2.06 (tos206 partition)"
    endchoice

    config ST_TOS_PARTITION
        string
        default "tos162" if ST_TOS_162
        default "tos206" if ST_TOS_206

    choice ST_RAM
        prompt "ST RAM size"
        default ST_RAM_1MB

        config ST_RAM_512KB
            bool "512 KB"
        config ST_RAM_1MB
            bool "1 MB"
        config ST_RAM_2MB
            bool "2 MB"
        config ST_RAM_4MB
            bool "4 MB"
    endchoice

    config ST_RAM_KB
        int
        default 512 if ST_RAM_512KB
        default 1024 if ST_RAM_1MB
        default 2048 if ST_RAM_2MB
        default 4096 if ST_RAM_4MB

    config ST_MONO
        bool "Monochrome monitor (SM124, 640x400)"
        default n
        help
            Without this the ST has a colour monitor (320x200 / 640x200).

    config ST_ANY_RESOLUTION
        bool "Offer Low, Medium and High resolution"
        default y
        help
            The desktop's Set Preferences offers all three resolutions
            whatever the monitor (TOS 1.62 and 2.06 are patched in RAM), and
            the emulated monitor follows the mode TOS sets, like a multisync
            monitor. Without this, High needs the monochrome monitor and Low
            and Medium the colour one, as on a real ST.

    config ST_HD
        bool "SD card as hard disk C:"
        default y
        help
            A folder on the microSD card appears to the ST as drive C:
            (GEMDOS level: copy .PRG files onto the card from any computer,
            no disk image or hard disk driver needed).

    config ST_HD_FOLDER
        string "Folder on the SD card for C:"
        depends on ST_HD
        default ""
        help
            Relative to the card's root, e.g. "ATARI". Empty: the whole card.

    config ST_HD_BOOT
        bool "Boot from C:"
        depends on ST_HD
        default y
        help
            TOS runs C:\AUTO and reads DESKTOP.INF from C:, and skips its
            wait for an ACSI hard disk.

    config ST_FLOPPY_FOLDER
        string "Folder on the SD card for floppy disk images"
        default "floppies"
        help
            Relative to the card's root. Disk images (.ST, .MSA) in it can be
            put into drives A: and B: on the setup screen or the web page;
            new blank disks (EMPTY0001.ST, ...) are made there. Made if
            missing.

endmenu

# WiFi, web page, setup screen, Bluetooth and speaker: "Emulator board"
# (../esp32emu/components/emu/Kconfig)
```
